## app/sed_demo/Kconfig
```kconfig
# Voice Signal Preprocess
# Copyright (C) 2001-2023 NationalChip Co., Ltd
# ALL RIGHTS RESERVED!
#
# Kconfig:
#
#---------------------------------------------------------------------------------#

if LVP_APP_SED_DEMO

    config LVP_APP_SED_DEMO_SNORING_LED
        int "snoring led GPIO port"
        default 3

    config LVP_APP_SED_DEMO_BABYCRYING_LED
        int "babycrying GPIO port"
        default 4

endif
```

## lvp/vui/sed/models/Kconfig
```kconfig
# Voice Signal Preprocess
# Copyright (C) 2001-2019 NationalChip Co., Ltd
# ALL RIGHTS RESERVED!
#
# Kconfig: KWS Kconfig
#---------------------------------------------------------------------------------#

# kws version list
choice
    prompt "SED Select:"
    config LVP_ENABLE_RNN_SED
        bool "ENABLE RNN SED"

endchoice

if LVP_ENABLE_RNN_SED
    choice
        prompt "RNN SED Model Select:"
        source "lvp/vui/sed/models/rnn_sed/*/sed.name"
    endchoice

    config LVP_ENABLE_RNN_SED_STATE_RESET
        bool "Periodic reset state"
        default n
    if LVP_ENABLE_RNN_SED_STATE_RESET
        config LVP_ENABLE_RNN_SED_STATE_RESET_INTERVAL
        int "Interval of reset state (s)"
        default 10
    endif

    source "lvp/vui/sed/models/rnn_sed/*/version.list"
    source "lvp/vui/sed/models/rnn_sed/*/*/Kconfig"
endif

#---------------------------------------------------------------------------------#
```

## lvp/vui/sed/models/rnn_sed/development/v0.1.1/Kconfig
```kconfig
menu "Model Param Setting:"
    depends on LVP_RNN_SED_MODEL_V0_1_1_2024_0116

    # Byte
    config SED_SNPU_BUFFER_SIZE
        default 776

    config SED_MODEL_FEATURES_DIM_PER_FRAME
        default 256

    config SED_MODEL_FEATURES_PADDING_NUM
        default 0

    config SED_MODEL_EFFECTIVE_FEATURES_PER_FRAME
        default 256

    config SED_MODEL_INPUT_STRIDE_LENGTH
        default 1

    config SED_MODEL_INPUT_WIN_LENGTH
        default 1

    config SED_MODEL_OUTPUT_LENGTH
        default 2

endmenu
```

## lvp_sed/3rdparty/opencore-amr/Kconfig
```kconfig
# Voice Signal Preprocess
# Copyright (C) 2001-2020 NationalChip Co., Ltd
# ALL RIGHTS RESERVED!
#
# Kconfig: VSP 3rd party Kconfig
#
#---------------------------------------------------------------------------------#

choice
prompt "select sample rate:"
depends on USE_AMR
default USE_AMR_NB
    config USE_AMR_NB
        depends on USE_AMR
        bool "use 8k samplerate dec"
        help
            use amr decoder
    config USE_AMR_WB
        depends on USE_AMR
        bool "use 16k samplerate dec"
        help
            use amr decoder
endchoice
```

## lvp_sed/lvp/vui/sed/Kconfig
```kconfig
#
# Grus
# Copyright (C) 2001-2020 NationalChip Co., Ltd
# ALL RIGHTS RESERVED!
#
# Kconfig: Gurs Kconfig
#---------------------------------------------------------------------------------#
# Public Model Values
config SED_SNPU_BUFFER_SIZE
    int

config SED_MODEL_FEATURES_DIM_PER_FRAME
    int

config SED_MODEL_FEATURES_PADDING_NUM
    int

config SED_MODEL_FEATURES_PADDING_NUM_LEFT
    int

config SED_MODEL_FEATURES_PADDING_NUM_RIGHT
    int

config SED_MODEL_EFFECTIVE_FEATURES_PER_FRAME
    int

config SED_MODEL_INPUT_STRIDE_LENGTH
    int

config SED_MODEL_INPUT_WIN_LENGTH
    int

config SED_MODE_EXTRA_INPUT_FRAME
    int

config SED_MODEL_OUTPUT_LENGTH
    int

config NPU_TOTAL_SIZE
    int
#---------------------------------------------------------------------------------#

source "lvp/vui/sed/models/Kconfig"
source "lvp/vui/sed/post_processing/Kconfig"

#---------------------------------------------------------------------------------#
```

## lvp_sed/lvp/vui/sed/post_processing/Kconfig
```kconfig
# Voice Signal Preprocess
# Copyright (C) 2001-2021 NationalChip Co., Ltd
# ALL RIGHTS RESERVED!
#
# Kconfig: Post-Processing Kconfig
#---------------------------------------------------------------------------------#

menuconfig ENABLE_POST_PROCESSING
    bool "Enable Post Processing"
    default y

    if ENABLE_POST_PROCESSING
    choice
        prompt "Scenes Select:"
        default POST_PROCESSING_NULL
        source "lvp/vui/sed/post_processing/*/post_processing.name"
    endchoice


    config VED_SNORING_THRESHOLD
        int "Snoring Thershold"
        default 94

    config VED_BABYCRYING_THRESHOLD
        int "Babycrying Thershold"
        default 90
    
    source "lvp/vui/sed/post_processing/*/Kconfig"
    endif
```

## lvp_sed/lvp/vui/sed/post_processing/development/Kconfig
```kconfig
# Voice Signal Preprocess
# Copyright (C) 2001-2021 NationalChip Co., Ltd
# ALL RIGHTS RESERVED!
#
# Kconfig: POST-PROCESSING Kconfig
#---------------------------------------------------------------------------------#
if POST_PROCESSING_DEVELOPMENT
    choice
        prompt "development processing select:"
        default POST_PROCESSING_DEVELOPMENT_V0_0_1_2023_0725
        source "lvp/vui/sed/post_processing/development/*/post_processing_version.name"
    endchoice

    source "lvp/vui/sed/post_processing/development/*/Kconfig"
endif
```

## lvp_sed/lvp/vui/sed/post_processing/development/v0.0.1/Kconfig
```kconfig
menu "Post Process Setting:"
    depends on POST_PROCESSING_DEVELOPMENT_V0_0_1_2023_0725

endmenu
```

## lvp_sed/lvp/vui/sed/post_processing/development/v0.0.2/Kconfig
```kconfig
menu "Post Process Setting:"
    depends on POST_PROCESSING_DEVELOPMENT_V0_0_2_2023_0901

endmenu
```
